## sdkconfig.defaults
```kconfig
CONFIG_IDF_TARGET="esp32s3"
CONFIG_ESPTOOLPY_FLASHMODE_QIO=y
CONFIG_ESPTOOLPY_FLASHSIZE_16MB=y
CONFIG_PARTITION_TABLE_CUSTOM=y
CONFIG_PARTITION_TABLE_CUSTOM_FILENAME="partitions.csv"
CONFIG_COMPILER_OPTIMIZATION_PERF=y
CONFIG_ESP_DEFAULT_CPU_FREQ_MHZ_240=y
CONFIG_FREERTOS_HZ=1000
CONFIG_SPIRAM=y
CONFIG_SPIRAM_MODE_OCT=y
CONFIG_SPIRAM_FETCH_INSTRUCTIONS=y
CONFIG_SPIRAM_RODATA=y
CONFIG_SPIRAM_SPEED_80M=y
CONFIG_SPIRAM_MALLOC_ALWAYSINTERNAL=0
CONFIG_SPIRAM_TRY_ALLOCATE_WIFI_LWIP=y
CONFIG_SPIRAM_XIP_FROM_PSRAM=y
CONFIG_ESP32S3_INSTRUCTION_CACHE_32KB=y
CONFIG_ESP32S3_DATA_CACHE_64KB=y
CONFIG_ESP32S3_DATA_CACHE_LINE_64B=y
CONFIG_BSP_I2C_NUM=1
CONFIG_BSP_I2C_FAST_MODE=y
CONFIG_BSP_I2C_CLK_SPEED_HZ=400000
CONFIG_BSP_LCD_TRANS_QUEUE_DEPTH=4
CONFIG_BSP_DISPLAY_BRIGHTNESS_LEDC_CH=1
# Enable LVGL image decoder (PNG) support
CONFIG_ESP_LVGL_ADAPTER_ENABLE_DECODER=y
# LVGL refresh period 16ms -> up to 60fps (default 33ms = 30fps)
CONFIG_LV_DEF_REFR_PERIOD=16
```
